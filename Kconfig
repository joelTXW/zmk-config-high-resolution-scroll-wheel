## Kconfig
```kconfig
menu "HighRes Custom Features"

config HIGHRES_PERSIST_SENSITIVITY_LAYER
    bool "Persist sensitivity layer selection"
    default y
    depends on SETTINGS
    help
      Save and restore the selected sensitivity layer across reboots.

endmenu
```

## boards/shields/high-resolution-scroll-wheel/Kconfig.defconfig
```kconfig
if SHIELD_HIGH_RESOLUTION_SCROLL_WHEEL

config ZMK_KEYBOARD_NAME
    default "Hi-Res Scroll"

endif
```

## boards/shields/high-resolution-scroll-wheel/Kconfig.shield
```kconfig
config SHIELD_HIGH_RESOLUTION_SCROLL_WHEEL
    def_bool $(shields_list_contains,high-resolution-scroll-wheel)
```

## config/west.yml
```yaml
manifest:
  remotes:
    - name: zmkfirmware
      url-base: https://github.com/zmkfirmware
    - name: joelTXW
      url-base: https://github.com/joelTXW
    # Additional modules containing boards/shields/custom code can be listed here as well
    # See https://docs.zephyrproject.org/3.2.0/develop/west/manifest.html#projects
  projects:
    - name: zmk
      remote: zmkfirmware
      revision: v0.2
      import: app/west.yml
    - name: zmk-driver-ams-as5600
      remote: joelTXW
      revision: main
  self:
    path: config
```
